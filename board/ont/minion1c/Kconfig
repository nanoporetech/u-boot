## board/ont/minion1c/Kconfig
```kconfig
# Copyright (c) 2019, Oxford Nanopore Technolgies Ltd.
#
# SPDX-License-Identifier: GPL-2.0

if TARGET_MINION1C

config SYS_BOARD
	default "minion1c"

config SYS_VENDOR
	default "ont"

config SYS_CONFIG_NAME
	default "minion1c"

endif
```

## board/ont/minit/Kconfig
```kconfig
# Copyright (c) 2016, NVIDIA CORPORATION.
#
# SPDX-License-Identifier: GPL-2.0

if TARGET_MINIT

config SYS_BOARD
	default "minit"

config SYS_VENDOR
	default "ont"

config SYS_CONFIG_NAME
	default "minit"

endif
```
